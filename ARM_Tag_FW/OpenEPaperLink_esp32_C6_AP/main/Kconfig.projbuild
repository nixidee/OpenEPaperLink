## ARM_Tag_FW/OpenEPaperLink_esp32_C6_AP/main/Kconfig.projbuild
```kconfig
menu "OEPL config"

  choice OEPL_HARDWARE_PROFILE
    prompt "Hardware profile"
    default OEPL_HARDWARE_PROFILE_DEFAULT

    config OEPL_HARDWARE_PROFILE_DEFAULT
      bool "Default"

    config OEPL_HARDWARE_PROFILE_POE_AP
      bool "PoE-AP"

    config OEPL_HARDWARE_PROFILE_CUSTOM
      bool "Custom"

    config OEPL_HARDWARE_PROFILE_LILYGO
      bool "LILYGO-AP"

    config OEPL_HARDWARE_PROFILE_4inch
      bool "4inchAP"
      
    config OEPL_HARDWARE_PROFILE_ELECROW_C6
      bool "ELECROW-C6-AP"

    config OEPL_HARDWARE_PROFILE_XIAO_C6
      bool "Seeed XIAO ESP32C6"
      help
        Seeed Studio XIAO ESP32C6 with external UFL antenna.
        UART: TX=GPIO16 (D6), RX=GPIO17 (D7).
        External antenna is activated via GPIO3 (RF switch power, active-low)
        and GPIO14 (antenna select, high=external UFL).
        No CC1101 - uses built-in 802.15.4 radio only.
        Connect to XIAO ESP32S3 Plus: S3-D6(GPIO43)->C6-D7, S3-D7(GPIO44)<-C6-D6.
        Power: connect S3 5V-pin to C6 5V-pin (USB-C only on S3!).

  endchoice

  config OEPL_HARDWARE_UART_TX
    depends on OEPL_HARDWARE_PROFILE_CUSTOM
    int "GPIO - UART TX"
    default 3

  config OEPL_HARDWARE_UART_RX
    depends on OEPL_HARDWARE_PROFILE_CUSTOM
    int "GPIO - UART RX"
    default 2

  config OEPL_HARDWARE_UART_TX
    depends on OEPL_HARDWARE_PROFILE_4inch || OEPL_HARDWARE_PROFILE_XIAO_C6
    int "GPIO - UART TX"
    default 16

  config OEPL_HARDWARE_UART_RX
    depends on OEPL_HARDWARE_PROFILE_4inch || OEPL_HARDWARE_PROFILE_XIAO_C6
    int "GPIO - UART RX"
    default 17

  config OEPL_SUBGIG_SUPPORT
    bool "Enable SubGhz Support"
    default "n"    

  menu "CC1101 Configuration" 
    depends on OEPL_SUBGIG_SUPPORT

    config GPIO_RANGE_MAX
            int
            default 33 if IDF_TARGET_ESP32
            default 46 if IDF_TARGET_ESP32S2
            default 48 if IDF_TARGET_ESP32S3
            default 18 if IDF_TARGET_ESP32C2
            default 19 if IDF_TARGET_ESP32C3
            default 30 if IDF_TARGET_ESP32C6
            default 30 if IDF_TARGET_ESP32H2

    config MISO_GPIO
            int "CC1101 MISO GPIO"
            range 0 GPIO_RANGE_MAX
            default 7
            help
                    Pin Number to be used as the MISO SPI signal.

    config SCK_GPIO
            int "CC1101 SCK GPIO"
            range 0 GPIO_RANGE_MAX
            default 0
            help
                    Pin Number to be used as the SCK SPI signal.

    config MOSI_GPIO
            int "CC1101 MOSI GPIO"
            default 1
            help
                    Pin Number to be used as the MOSI SPI signal.

    config CSN_GPIO
            int "CC1101 CSN GPIO"
            range 0 GPIO_RANGE_MAX
            default 4
            help
                    Pin Number to be used as the CSN SPI signal.

    config GDO0_GPIO
            int "CC1101 GDO0 GPIO"
            range 0 GPIO_RANGE_MAX
            default 5
            help
                    Pin Number to be used as the GDO0 signal.

    config GDO2_GPIO
            int "CC1101 GDO2 GPIO"
            range 0 GPIO_RANGE_MAX
            default 6
            help
                    Pin Number to be used as the GDO2 signal.

    choice SPI_HOST
            prompt "SPI peripheral that controls this bus"
            default SPI2_HOST
            help
                    Select SPI peripheral that controls this bus.
            config SPI2_HOST
                    bool "SPI2_HOST"
                    help
                            Use SPI2_HOST. This is also called HSPI_HOST.
            config SPI3_HOST
                    depends on IDF_TARGET_ESP32 || IDF_TARGET_ESP32S2 || IDF_TARGET_ESP32S3
                    bool "SPI3_HOST"
                    help
                            USE SPI3_HOST. This is also called VSPI_HOST
    endchoice
  endmenu

  config OEPL_DEBUG_PRINT
    bool "Enable OEPL Debug logging"
    default "n"    

  config OEPL_VERBOSE_DEBUG
    depends on OEPL_DEBUG_PRINT
    bool "Enable OEPL Verbose Debug logging"
    default "n"    

endmenu
```
